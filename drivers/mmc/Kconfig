## drivers/mmc/Kconfig
```kconfig
# SPDX-License-Identifier: GPL-2.0-only
#
# MMC subsystem configuration
#

menuconfig MMC
	tristate "MMC/SD/SDIO card support"
	depends on HAS_IOMEM
	help
	  This selects MultiMediaCard, Secure Digital and Secure
	  Digital I/O support.

	  If you want MMC/SD/SDIO support, you should say Y here and
	  also to your specific host controller driver.

config MMC_SUPPORT_STLOG
	bool "Enable storage log"
	depends on MMC && PROC_STLOG
	default y

if MMC

source "drivers/mmc/core/Kconfig"

source "drivers/mmc/host/Kconfig"

endif # MMC
```

## drivers/staging/android/Kconfig
```kconfig
# SPDX-License-Identifier: GPL-2.0
menu "Android"

if ANDROID

config SAMSUNG_BINDER_MONITOR
	bool "monitor binder transaction"
	default n
	help
	  monitor binder transaction and resitrict it.

config ASHMEM
	bool "Enable the Anonymous Shared Memory Subsystem"
	depends on SHMEM
	help
	  The ashmem subsystem is a new shared memory allocator, similar to
	  POSIX SHM but with different behavior and sporting a simpler
	  file-based API.

	  It is, in theory, a good memory allocator for low-memory devices,
	  because it can discard shared memory units when under memory pressure.

config DEBUG_KINFO
	bool "Debug Kernel Information Support"
	depends on KALLSYMS
	help
	  This supports kernel information backup for bootloader usage.
	  Specifics:
	   - The kallsyms symbols for unwind_backtrace
	   - Page directory pointer
	   - UTS_RELEASE
	   - BUILD_INFO(ro.build.fingerprint)

config SAMSUNG_LMKD_DEBUG
	bool "record lmkd kill history"
	default y
	help
	  record lmkd kill history

config SAMSUNG_FREECESS
	bool "thraw frozen process when recv sig"
	default n
	help
	  thraw frozen process when recv sig.

endif # if ANDROID

endmenu
```

## mm/sec_mm/Kconfig
```kconfig
menu "SEC Memory Management Options"

config SEC_MM
	tristate "Enable SEC MM"
	depends on DMA_SHARED_BUFFER
	default y
	help
	  SEC memory management module

endmenu
```

## net/ncm/Kconfig
```kconfig
#
# Network Context Module Configuration
#
# SEC_PRODUCT_FEATURE_KNOX_SUPPORT_NPA {
config KNOX_NCM
  tristate "Network Context Module Support"
  depends on NET
  default n
# SEC_PRODUCT_FEATURE_KNOX_SUPPORT_NPA }
```

## security/samsung/defex_lsm/Kconfig
```kconfig
config SECURITY_DEFEX
	bool "Defex Support"
	depends on SECURITY && (!KCOV || SAMSUNG_PRODUCT_SHIP)
	select CRYPTO
	select CRYPTO_RSA
	select CRYPTO_SHA1
	select CRYPTO_SHA256
	select CRYPTO_HASH_INFO
	select INTEGRITY_SIGNATURE
	select INTEGRITY_ASYMMETRIC_KEYS
	default n
	help
	  This selects the Defex support.
	  If you are unsure how to answer this question, answer N.

config DEFEX_KERNEL_ONLY
	bool "Defex Kernel Only"
	depends on SECURITY_DEFEX
	default n
	help
	  This lets defex know whether kernel-only build or not.
	  Default value will be set to "y" if the build is kernel-only.
	  And it will be changed to "n" by build.py at platform-build.

config SECURITY_DEFEX_USER
	bool "Defex USER build"
	depends on SECURITY_DEFEX
	default n
	help
	  This lets defex to know whether USER build performed or not
	  in case of TARGET_BUILD_VARIANT variable is empty.
```

## security/samsung/dsms/Kconfig
```kconfig
config SECURITY_DSMS
	bool "DSMS Support"
	depends on SECURITY
	default n
	help
	  This selects the DSMS support.
	  If you are unsure how to answer this question, answer N.
```

## security/samsung/five/Kconfig
```kconfig
# Task Integrity Verifier

config FIVE
	bool "File Based Task Integrity Verifier (FIVE)(based on IMA)"
	depends on INTEGRITY && DM_VERITY && BLK_DEV_LOOP
	select CRYPTO
	select CRYPTO_SHA1
	select CRYPTO_SHA1_ARM64_CE if ARM64_CRYPTO && KERNEL_MODE_NEON
	select CRYPTO_HASH_INFO
	select INTEGRITY_SIGNATURE
	select INTEGRITY_ASYMMETRIC_KEYS
	default n
	help
	  File Based Task Integrity Verifier (FIVE) maintains
	  signatures of executables and other sensitive system files,
	  as they are read or executed. If an attacker manages
	  to change the contents of an important system file
	  being measured, we can tell.

config FIVE_GKI_10
	bool "GKI 1.0 compatible version of FIVE"
	depends on FIVE
	default n
	help
	 Build GKI 1.0 compatible version of FIVE

config FIVE_GKI_20
	bool "GKI 2.0 compatible version of FIVE"
	depends on FIVE
	default n
	help
	 Build GKI 2.0 compatible version of FIVE

config FIVE_DEBUG
	bool "FIVE Debug mode"
	depends on FIVE
	default n
	help
	 Enable the debug mode in the FIVE

config FIVE_CERT_ENG
    string "FIVE certificate to verify signatures for eng binary"
    depends on FIVE_DEBUG
    default "x509_five_eng.der"
    help
      Path to CERT which will be built-in to eng binary

config FIVE_CERT_USER
    string "FIVE certificate to verify signatures for user binary"
    depends on FIVE
    default "x509_five_user.der"
    help
      Path to CERT which will be built-in to user binary

choice
	prompt "Default integrity hash algorithm"
	depends on FIVE
	default FIVE_DEFAULT_HASH_SHA1
	help
	   Select the default hash algorithm used for the measurement
	   list, integrity appraisal and audit log.

	config FIVE_DEFAULT_HASH_SHA1
		bool "SHA1 (default)"
		depends on CRYPTO_SHA1

	config FIVE_DEFAULT_HASH_SHA256
		bool "SHA256"
		depends on CRYPTO_SHA256

	config FIVE_DEFAULT_HASH_SHA512
		bool "SHA512"
		depends on CRYPTO_SHA512

	config FIVE_DEFAULT_HASH_WP512
		bool "WP512"
		depends on CRYPTO_WP512
endchoice

config FIVE_DEFAULT_HASH
	string
	depends on FIVE
	default "sha1" if FIVE_DEFAULT_HASH_SHA1
	default "sha256" if FIVE_DEFAULT_HASH_SHA256
	default "sha512" if FIVE_DEFAULT_HASH_SHA512
	default "wp512" if FIVE_DEFAULT_HASH_WP512

config FIVE_TRUSTED_KEYRING
	bool "Require all keys on the .five keyring be signed"
	depends on FIVE && SYSTEM_TRUSTED_KEYRING
	default y
	help
	   This option requires that all keys added to the .five
	   keyring be signed by a key on the system trusted keyring.

config FIVE_PA_FEATURE
	bool "Process authenticator"
	depends on FIVE && !PROCA
	default y
	help
	   Enable Process Authenticator related code

config FIVE_AUDIT_VERBOSE
	bool "FIVE verbose audit logs"
	depends on FIVE_DEBUG
	default n
	help
	   Enable verbose audit logs.
```

## security/samsung/kumiho/Kconfig
```kconfig
config SECURITY_KUMIHO
	bool "Kumiho Support"
	depends on SECURITY
	default n
	help
	  This selects Kumiho support.
	  If you are unsure how to answer this question, answer N.
```

## security/samsung/mz/Kconfig
```kconfig
#
# MZ configuration
#

config MEMORY_ZEROISATION
	bool "Support memory zeroisation"
	default n
	help
      Support memory zeroisation feature which does zeroing of free pages.
      The purpose of this is to zeroise specific memory
      when target process exit.

config MZ_PAGE_V2
	bool "Page functions version"
	default n
	help
      MZ page management code have dependency on kernel.
      This version need to be change when kernel page code is changed.

config MZ_USE_QSEECOM
	tristate "MZ Crypto TEE Driver"
	help
	  Enable MZ crypto Trusted Execution Environment support
	  MZ use crypto function and it will be works in tee
	  if it's supported
	  This driver is interface for MZ NWd and MZ ta
```

## security/samsung/mz_tee_driver/Kconfig
```kconfig
#
# TEE Driver configuration
#

config MZ_TEE_DRIVER
    tristate "Crypto TEE Driver"
    depends on MEMORY_ZEROISATION
    default y
    help
      Enable MZ crypto Trusted Execution Environment support
      MZ use crypto function and it will be works in tee
      if it's supported
      This driver is interface for MZ NWd and MZ ta

choice
    prompt "MZ Secure OS"
    depends on MZ_TEE_DRIVER
    default MZ_USE_QSEECOM if QSEECOM
    default MZ_USE_TZDEV if TZDEV
    default MZ_USE_TRUSTONIC if TRUSTONIC_TEE
    default MZ_DEFAULT
    help
      Select Secure OS for MZ

    config MZ_USE_TRUSTONIC
        bool "MZ based on Trustonic Secure OS"
        depends on TRUSTONIC_TEE
        help
          Use Trustonic as base Trusted Execution Environment

    config MZ_USE_TZDEV
        bool "MZ based on TEEgris Secure OS"
        depends on TZDEV
        help
          Use TEEgris as base Trusted Execution Environment

    config MZ_USE_QSEECOM
        bool "MZ based on Qualcomm Secure OS"
        depends on QSEECOM
        help
          Use Qualcomm as base Trusted Execution Environment

    config MZ_DEFAULT
        bool "MZ Disabled"
        help
          MZ disabled
endchoice
```

## security/samsung/proca/Kconfig
```kconfig
#
# PROCA feature configuration
#

config PROCA
	bool "Process Authenticator"
	depends on FIVE
	default n
	help
	   Enable Process Authenticator

config PROCA_GKI_10
	bool "GKI 1.0 compatible version of PROCA"
	depends on PROCA
	default y if FIVE_GKI_10
	default n
	help
	   Build GKI 1.0 compatible version of PROCA

config PROCA_S_OS
	bool "S OS compatible version of PROCA"
	depends on PROCA
	default n
	help
	   Build S OS compatible version of PROCA

config PROCA_DEBUG
	bool "PROCA Debug mode"
	depends on PROCA && !SAMSUNG_PRODUCT_SHIP
	default y
	help
	   Enable the debug mode in the PROCA. When this option is enabled
	   PROCA driver creates file /proc/<pid>/integrity/proca_certificate
	   which contains hex representation of binary proca certificate. It
	   might be used to check existence of task descriptor for some task
	   in proca table.
```

## security/samsung/proca/gaf/Kconfig
```kconfig
config GAF
	bool "Use GAF structure"
	default y if PROCA || FIVE
	default n
	help
	  Enable GAF structure

if GAF
# When adding new entries keep the list in alphabetical order
choice
	prompt "Version of GAF structure"
	default GAF_V5 if PROCA
	default GAF_V4 if FIVE
	default GAF_V3
	config GAF_V3
		bool "Use GAF structure version 3"
		help
		  Default option for FIVE-disabled kernel
	config GAF_V4
		bool "Use GAF structure version 4"
		help
		  Default option for kernel without PROCA LSM module.
	config GAF_V5
		bool "Use GAF structure version 5"
		help
		  Default option for kernel with PROCA 2.0-2.1 LSM module.
	config GAF_V6
		bool "Use GAF structure version 6"
		help
		  Default option for kernel with PROCA 2.2+ LSM module.
endchoice

endif #GAF
```
